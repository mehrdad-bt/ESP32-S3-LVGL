## sdkconfig.defaults
```kconfig
CONFIG_FREERTOS_HZ=1000

CONFIG_ESPTOOLPY_FLASHSIZE_2MB=n
CONFIG_ESPTOOLPY_FLASHSIZE_16MB=y
CONFIG_ESPTOOLPY_FLASHSIZE="16MB"

CONFIG_PARTITION_TABLE_CUSTOM=y
CONFIG_PARTITION_TABLE_CUSTOM_FILENAME="partitions.csv"
CONFIG_PARTITION_TABLE_FILENAME="partitions.csv"

CONFIG_SPIRAM=y
CONFIG_SPIRAM_MODE_OCT=y
CONFIG_SPIRAM_SPEED_80M=y

CONFIG_FATFS_LFN_HEAP=y
CONFIG_FATFS_MAX_LFN=255

CONFIG_ESP_MAIN_TASK_STACK_SIZE=8192
CONFIG_AUTOSTART_ARDUINO=y
CONFIG_ARDUINO_LOOP_STACK_SIZE=16384
```
